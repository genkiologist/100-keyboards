## boards/shields/100_keyboards/Kconfig.shield
```kconfig
config SHIELD_100_KEYBOARDS_CENTRAL
    def_bool $(shields_list_contains,100_keyboards_central)

config SHIELD_100_KEYBOARDS_PERI_1
    def_bool $(shields_list_contains,100_keyboards_peri_1)

config SHIELD_100_KEYBOARDS_PERI_2
    def_bool $(shields_list_contains,100_keyboards_peri_2)

config SHIELD_100_KEYBOARDS_PERI_3
    def_bool $(shields_list_contains,100_keyboards_peri_3)

config SHIELD_100_KEYBOARDS_PERI_4
    def_bool $(shields_list_contains,100_keyboards_peri_4)
```

## config/west.yml
```yaml
manifest:
  remotes:
    - name: zmkfirmware
      url-base: https://github.com/zmkfirmware
    - name: sekigon-gonnoc
      url-base: https://github.com/sekigon-gonnoc
    - name: urob
      url-base: https://github.com/urob
  projects:
    - name: zmk
      remote: zmkfirmware
      revision: main
      import: app/west.yml
    - name: zmk-component-bmp-boost
      remote: sekigon-gonnoc
      import: west.yml
      revision: master      # ★ここは master
    - name: zmk-feature-status-led
      remote: sekigon-gonnoc
      revision: main        # ここは main
    - name: zmk-driver-paw3222
      remote: sekigon-gonnoc
      revision: main        # ここは main
    - name: zmk-feature-cdc-acm-bootloader-trigger
      remote: sekigon-gonnoc
      revision: main        # ★ここは main
    - name: zmk-feature-non-lipo-battery-management
      remote: sekigon-gonnoc
      revision: main        # ここは main
    - name: zmk-pointing-processors
      remote: urob
      revision: main
  self:
    path: config
```
