#include "100_keyboards.dtsi"

&default_transform {
    col-offset = <20>; // 自分のCOL0を、全体のCOL20としてセントラルに送信
};
/ {
    split_inputs {
        #address-cells = <1>;
        #size-cells = <0>;

        trackball_split: trackball_split@0 {
            compatible = "zmk,input-split";
            reg = <0>;
            device = <&trackball>; // 自分の物理トラックボールのデータを送信
        };
    };
};
